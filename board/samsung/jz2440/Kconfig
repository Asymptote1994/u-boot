## board/samsung/jz2440/Kconfig
```kconfig
if TARGET_JZ2440

config SYS_BOARD
	default "jz2440"

config SYS_VENDOR
	default "samsung"

config SYS_SOC
	default "s3c2440"

config SYS_CONFIG_NAME
	default "jz2440"

endif
```

## configs/jz2440_defconfig
```kconfig
# Architecture and machine
CONFIG_ARM=y
CONFIG_TARGET_JZ2440=y

# Link address
CONFIG_SYS_TEXT_BASE=0x32000000

# Boot opration and Cli
CONFIG_BOOTDELAY=3
CONFIG_HUSH_PARSER=y
CONFIG_SYS_PROMPT="JZ2440 # "
CONFIG_USE_BOOTARGS=y
CONFIG_BOOTARGS="noinitrd root=/dev/mmcblk0p2 rootwait rw rootfstype=ext4 earlyprintk console=ttySAC0,115200 user_debug=31"
CONFIG_OF_LIBFDT=y

# Command
CONFIG_CMD_FAT=y
CONFIG_CMD_BOOTM=y
CONFIG_CMD_MMC=y

# Device tree
CONFIG_OF_CONTROL=y
CONFIG_OF_SEPARATE=y
CONFIG_DEFAULT_DEVICE_TREE="jz2440"

# Device model
CONFIG_DM=y

# Clock driver
CONFIG_CLK=y
CONFIG_CLK_S3C2440=y

# Timer driver
CONFIG_TIMER=y
CONFIG_S3C2440_TIMER=y

# Serial driver
CONFIG_BAUDRATE=115200
CONFIG_DM_SERIAL=y
CONFIG_S3C2440_SERIAL=y
CONFIG_PRE_CONSOLE_BUFFER=y
CONFIG_PRE_CON_BUF_SZ=512
CONFIG_PRE_CON_BUF_ADDR=0x30000000

# SD/MMC driver
CONFIG_MMC=y
CONFIG_DM_MMC=y
CONFIG_MMC_S3C2440=y
CONFIG_BLK=y

# Pinctrl driver
CONFIG_PINCTRL=y
CONFIG_PINCTRL_S3C2440=y

# GPIO driver
CONFIG_DM_GPIO=y
CONFIG_S3C2440_GPIO=y

# USB driver
CONFIG_USB=y
CONFIG_DM_USB=y
CONFIG_DM_USB_GADGET=y
CONFIG_USB_GADGET=y
CONFIG_USB_GADGET_S3C2440=y

CONFIG_CMD_USB=y
CONFIG_CMD_USB_MASS_STORAGE=y
CONFIG_USB_GADGET_DOWNLOAD=y

CONFIG_USB_GADGET_MANUFACTURER="JEEJIO"
CONFIG_USB_GADGET_VENDOR_NUM=0xfffe
CONFIG_USB_GADGET_PRODUCT_NUM=0xdf11
```
